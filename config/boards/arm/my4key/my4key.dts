/dts-v1/;
#include <nordic/nrf52840_qiaa.dtsi>

/ {
    model = "my4key";
    compatible = "my4key";

    chosen {
        zmk,kscan = &kscan0;
        zmk,battery = &vbatt;
        zmk,ble = &ble;
    };

    vbatt: vbatt {
        compatible = "zmk,battery-voltage-divider";
        io-channels = <&adc 2>;
    };
};
