#include <behaviors.dtsi>
#include <dt-bindings/zmk/keys.h>
#include <dt-bindings/zmk/bt.h>

 / {
     keymap {
         compatible = "zmk,keymap";

         default_layer {
             bindings = <
                &bt BT_CLR  &finder_downloads  &finder_desktop  &finder_home

             >;
         };
     };
 };
