## config/boards/shields/my4key/Kconfig.shield
```kconfig
config SHIELD_MY4KEY
    bool "My 4 Key Shield"
    default y

if SHIELD_MY4KEY

config ZMK_STUDIO_KEYMAP_PREVIEW
    bool "Enable ZMK Studio keymap preview"
    default y

endif
```
